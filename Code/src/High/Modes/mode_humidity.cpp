#include "High/Modes/mode_humidity.h"
#include <Arduino.h>
#include <Wire.h>
#include <Adafruit_I2CDevice.h>
#include <Adafruit_GFX.h>
#include <Adafruit_SSD1306.h>
#include "Adafruit_HTU21DF.h"
#include "Low/Outputs/output_display.h"


bool initialized = false;


TwoWire I2C_1 = TwoWire(1);


Adafruit_HTU21DF htu;  


float temp = 0.0f;
float rel_hum = 0.0f;








static const unsigned char PROGMEM image_Layer_7_bits[] = {0x00,0x30,0x00,0x00,0x30,0x00,0x00,0x30,0x00,0x00,0x30,0x00,0x00,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0xff,0x00};

static const unsigned char PROGMEM image_plant_bits[] = {0x00,0x00,0x00,0x0f,0x00,0x00,0x00,0x0f,0x00,0x00,0x00,0xff,0x00,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0x00,0x00};

static const unsigned char PROGMEM image_refresh_bits[] = {0x00,0x00,0x00,0x00,0x00,0x00,0x00,0x00,0x00,0xff,0xc3,0x00,0x00,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0x00,0x00};

static const unsigned char PROGMEM image_weather_frost_bits[] = {0x00,0x03,0x00,0x00,0x00,0x03,0x00,0x00,0x03,0x0f,0xc3,0x00,0x03,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0x00,0x00};

static const unsigned char PROGMEM image_weather_humidity_bits[] = {0x00,0x30,0x00,0x00,0x30,0x00,0x00,0x30,0x00,0x00,0x30,0x00,0x00,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0xff,0x00};

static const unsigned char PROGMEM image_weather_humidity_white_bits[] = {0x00,0x30,0x00,0x00,0x30,0x00,0x00,0x30,0x00,0x00,0x30,0x00,0x00,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0xff,0x00};

static const unsigned char PROGMEM image_weather_sun_bits[] = {0x00,0x03,0x00,0x00,0x00,0x03,0x00,0x00,0x0c,0x03,0x00,0xc0,0x0c,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0x00,0x00};

static const unsigned char PROGMEM image_weather_temperature_bits[] = {0x03,0xf0,0x00,0x00,0x03,0xf0,0x00,0x00,0x0c,0x0c,0x00,0x0c,0x0c,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0x00,0x00};



void drawScreen_1(void) {

        
    // weather_temperature
    display.drawBitmap(56, 3, image_weather_temperature_bits, 32, 32, 1);

    // Layer 6 copy 1
    display.setTextColor(1);
    display.setTextSize(2);
    display.setTextWrap(false);
    display.setCursor(4, 7);
    display.print(temp, 1);


    // Layer 6
    display.setCursor(41, 44);
    display.print(rel_hum, 1);

    
    // Layer 7
    display.drawBitmap(104, 31, image_Layer_7_bits, 22, 32, 1);
    
    // refresh
    if(temp >= 24.5)
        display.drawBitmap(96, 0, image_refresh_bits, 26, 32, 1);
    
    // weather_frost
    else if(temp <= 19)
        display.drawBitmap(94, 1, image_weather_frost_bits, 30, 32, 1);

    // weather_sun
    else
        display.drawBitmap(94, 0, image_weather_sun_bits, 30, 32, 1);

    // weather_humidity
    if(rel_hum < 40)
        display.drawBitmap(8, 31, image_weather_humidity_white_bits, 22, 32, 1);
    
    // weather_humidity_white
    else if (rel_hum > 60)
        display.drawBitmap(8, 31, image_weather_humidity_bits, 22, 32, 1);
    
    // plant
    else
        display.drawBitmap(5, 31, image_plant_bits, 32, 32, 1);
}



void humidity() {
    /***************************************************
  This is an example for the HTU21D-F Humidity & Temp Sensor

  Designed specifically to work with the HTU21D-F sensor from Adafruit
  ----> https://www.adafruit.com/products/1899

  These displays use I2C to communicate, 2 pins are required to
  interface
 ****************************************************/

    temp = htu.readTemperature();
    rel_hum = htu.readHumidity();
    Serial.print("Temp: "); Serial.print(temp); Serial.print(" C");
    Serial.print("\t\t");
    Serial.print("Humidity: "); Serial.print(rel_hum); Serial.println(" \%");
//    delay(500);
}


void init() {
    initialized = true;
    I2C_1.begin(1, 2, 100000); 

    if (!htu.begin(&I2C_1)) {
        Serial.println("Couldn't find sensor!");
    }
}
 

namespace Mode {
    void test() {
        if(!initialized) {
            init();
        }
        humidity();
        drawScreen_1();
    }
}

