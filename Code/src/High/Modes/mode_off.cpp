#include "High/Modes/mode_off.h"
#include "Low/Outputs/output_display.h"

namespace Images {
    static const unsigned char PROGMEM image_scorpion_bits[] = {0x00,0x00,0x00,0x00,0x00,0x00,0x00,0x00,0x00,0x00,0x00,0x00,0x00,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0x00,0x00};
    // static const unsigned char PROGMEM image_External_ant_1_bits[] = {0x7f,0xff,0xc0,0x80,0x00,0x20,0x88,0x02,0x20,0x92,0x49,0x20,0x94,0xe5,0x20,0x94,0xe5,0x20,0x92,0x49,0x20,0x88,0x42,0x20,0x80,0x40,0x20,0x80,0x00,0x20,0x7f,0xff,0xc0};
    static const unsigned char PROGMEM image_crocodile_bits[] = {0x00,0x00,0x00,0x00,0x00,0x00,0x00,0x00,0x00,0x00,0x00,0x0e,0x00,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0x00,0x00};
    
    static const unsigned char PROGMEM image_hand_peace_sign_bits[] = {0x10,0x40,0x28,0xa0,0x28,0xa0,0x28,0xa0,0x25,0x20,0x15,0x40,0x15,0x40,0x32,0x40,0x53,0x80,0x48,0x40,0xae,0x40,0x99,0x20,0x52,0x20,0x64,0x40,0x44,0x40,0x20,0x80};

    static const unsigned char PROGMEM image_network_www_bits[] = {0x03,0xc0,0x0d,0xb0,0x32,0x4c,0x24,0x24,0x44,0x22,0x7f,0xfe,0x88,0x11,0x88,0x11,0x88,0x11,0x88,0x11,0x7f,0xfe,0x44,0x22,0x24,0x24,0x32,0x4c,0x0d,0xb0,0x03,0xc0};
};

static void _drawScreen_0() {
    // Layer 3
    display.setTextColor(1);
    display.setTextSize(2);
    display.setTextWrap(false);

    display.setCursor(93, 4);
    display.print("S:");

    // Layer 4
    display.setCursor(114, 4);
    display.print("3");

    // Layer 6
    display.setCursor(53, 4);
    display.print("Yel");

    // Layer 3 copy 1
    display.setCursor(2, 50);
    display.print("G:");

    // Layer 4 copy 1
    display.setCursor(23, 50);
    display.print("0");

    // Layer 3 copy 2
    display.setCursor(50, 50);
    display.print("A:");

    // Layer 4 copy 2
    display.setCursor(71, 50);
    display.print("1");

    // Layer 3 copy 3
    display.setCursor(93, 50);
    display.print("M:");

    // Layer 4 copy 3
    display.setCursor(114, 50);
    display.print("2");

    // Layer 6 copy 1
    display.setCursor(53, 27);
    display.print(IN::gyro.offset);

    if(ST::state.isRobot_A) {
        // scorpion
        display.drawBitmap(7, 3, Images::image_scorpion_bits, 48, 48, 1);
    } else {
        // crocodile
        display.drawBitmap(1, 3, Images::image_crocodile_bits, 48, 48, 1);
    }

    if(IN::comms.onlineSoccer) {
        // hand_peace_sign
        display.drawBitmap(5, 3, Images::image_hand_peace_sign_bits, 11, 16, 1);
    } else {
        // network_www
        display.drawBitmap(3, 3, Images::image_network_www_bits, 16, 16, 1);
    }
}


static void _drawScreen_1() {

    
}

void mode_off_begin() {
    OUT::led_Debug.color = CRGB::Gray;
    OUT::led_Debug.needsUpdate = false;
    OUT::led_O.color = CRGB::Black;
    OUT::led_O.needsUpdate = true;
    OUT::led_X.color = CRGB::Black;
    OUT::led_X.needsUpdate = true;
    OUT::motorAcc.motEn = false;
}


namespace Mode {

    void off() {
        if(ST::state.mode_previous != ST::Types::mode_t::Off) { mode_off_begin();}
        
        OUT::display.needsUpdate = true;

        if(ST::offMenu.screen == ST::Types::screen_t::Main) {
            _drawScreen_0();
        } else if (ST::offMenu.screen == ST::Types::screen_t::Settings) {
            _drawScreen_1();
        }
    } 
}