#include "High/Modes/mode_controller.h"
#include "High/Roles/role_attacker.h"
#include "High/Roles/role_controller.h"
#include "Low/Outputs/output_display.h"
#include "Low/Inputs/input_communication.h"
#include "Low/Inputs/input_ps5_controller.h"

static constexpr unsigned char PROGMEM image_controller_bits[] = {0x00,0x00,0x00,0x00,0x00,0x00,0x00,0x00,0x00,0x00,0x00,0x00,0x00,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0x00,0x00};
// static constexpr unsigned char PROGMEM image_EviSmile1_bits[] = {0x0f,0x00,0x00,0x0f,0x00,0x0f,0x00,0x00,0x0f,0x00,0x3c,0x00,0x00,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0x00,0x00};
static const unsigned char PROGMEM image_device_key_retro_bits[] = {0x00,0x70,0x00,0x88,0x01,0x24,0x01,0x52,0x01,0x2a,0x00,0x92,0x01,0x44,0x02,0xb8,0x05,0x00,0x0a,0x00,0x14,0x00,0x28,0x00,0x54,0x00,0xa2,0x00,0x54,0x00,0x08,0x00};
static const unsigned char PROGMEM image_device_lock_bits[] = {0x0f,0x80,0x10,0x40,0x27,0x20,0x48,0x90,0x50,0x50,0x50,0x50,0x7f,0xf0,0xc0,0x18,0xa7,0x28,0x88,0x88,0x88,0x88,0x85,0x08,0x85,0x08,0xa2,0x28,0xc0,0x18,0x7f,0xf0};


static bool previouslyConnected = false;
static bool _initialized = false;


static void _drawScreen_CONTROLLER() {
    OUT::display.needsUpdate = true;
    display.setTextColor(1);
    display.setTextSize(1);
    display.setTextWrap(false);

    if (IN::controller.connected) {
        display.drawBitmap(32, 0, image_controller_bits, 64, 64, 1);
    } else {
        display.setCursor(29, 29);
        display.print("Connecting...");
    }

    previouslyConnected = IN::controller.connected;
}


namespace Mode {
    void controller() {
        if(ST::state.mode_previous != ST::Types::mode_t::Controller) { _initialized = false;}
         OUT::motorAcc.motEn = true; 

        if (!_initialized) {
            _initialized = true;
            input_controller_init_();
            Serial.println("Controller Mode");
            _drawScreen_CONTROLLER();
            OUT::led_O.needsUpdate = true;
            OUT::led_O.color = CRGB::White;
            OUT::led_X.needsUpdate = true;
            OUT::led_X.color = CRGB::White;
        }

        if (IN::controller.connected != previouslyConnected) {
            _drawScreen_CONTROLLER();
        }


        OUT::motorAcc.motEn = true;
        input_controller_update();

        if(IN::controller.psButton.Click) {
            ST::controller.autoPlay = !ST::controller.autoPlay;
        }

        if(ST::controller.autoPlay) {
            if(ST::controller.previousAutoPlay != ST::controller.autoPlay) {
                ST::controller.previousAutoPlay = ST::controller.autoPlay;
                OUT::display.needsUpdate = true;
                display.drawBitmap(32, 0, image_controller_bits, 64, 64, 1);
                display.drawBitmap(3, 2, image_device_lock_bits, 13, 16, 1);
                display.drawBitmap(112, 47, image_device_key_retro_bits, 15, 16, 1);
            }
            Role::attacker();
        } else {
            if(ST::controller.previousAutoPlay != ST::controller.autoPlay) {
                ST::controller.previousAutoPlay = ST::controller.autoPlay;
                OUT::display.needsUpdate = true;
                display.drawBitmap(32, 0, image_controller_bits, 64, 64, 1);
            }
            Role::controller();  
        }
    } 
}